## components/sensor/Kconfig
```kconfig
menu "App: sensor (M1)"

    config APP_SENSOR_MOCK
        bool "Use mock sensor (no I2C hardware)"
        default y
        help
            传感器型号与 I2C 引脚确认前，使用确定性虚拟数据验证采样流程、
            错误计数与业务不阻塞。确认后关闭此选项并实现 sensor_i2c.c。

endmenu
```

## tools/epd_hello/sdkconfig.defaults
```kconfig
# ESP32-C3 SuperMini (HW-466AB) 验证工程默认配置
CONFIG_ESP_CONSOLE_USB_SERIAL_JTAG=y
CONFIG_ESPTOOLPY_FLASHSIZE_4MB=y
```
